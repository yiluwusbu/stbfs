## fs/stbfs/Kconfig
```kconfig
config STB_FS
	tristate "Stbfs stackable file system (EXPERIMENTAL)"
	help
	  Wrapfs is a stackable file system which simply passes its
	  operations to the lower layer.  It is designed as a useful
	  template for developing or debugging other stackable file systems,
	  and more (see Documentation/filesystems/wrapfs.txt).  See
	  <http://wrapfs.filesystems.org/> for details.
		Stbfs builds upon Wrapfs and implements a trash bin.
```
